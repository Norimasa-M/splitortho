## config/boards/shields/splitoortho/Kconfig.defconfig
```kconfig
# Copyright (c) 2020 The ZMK Contributors
# SPDX-License-Identifier: MIT

if SHIELD_splitortho_LEFT

config ZMK_KEYBOARD_NAME
    default "splitortho"

config ZMK_SPLIT_ROLE_CENTRAL
    default y

endif

if SHIELD_splitortho_LEFT || SHIELD_splitortho_RIGHT

config ZMK_SPLIT
    default y

endif
```

## config/boards/shields/splitoortho/Kconfig.shield
```kconfig
# Copyright (c) 2020 The ZMK Contributors
# SPDX-License-Identifier: MIT

config SHIELD_splitortho_LEFT
    def_bool $(shields_list_contains,splitortho_left)

config SHIELD_splitortho_RIGHT
    def_bool $(shields_list_contains,splitortho_right)
```
